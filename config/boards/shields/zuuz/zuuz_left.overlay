/*
 * Copyright (c) 2020 The ZMK Contributors
 *
 * SPDX-License-Identifier: MIT
 */

#include "zuuz.dtsi"
&kscan0 {
    col-gpios
        = <&pro_micro 10 GPIO_ACTIVE_HIGH> // col1 in the schematic
        , <&pro_micro 10 GPIO_ACTIVE_HIGH> // col2 in the schematic
        , <&pro_micro 10 GPIO_ACTIVE_HIGH> // col3 in the schematic
        , <&pro_micro 10 GPIO_ACTIVE_HIGH> // col4 in the schematic
        , <&pro_micro 10 GPIO_ACTIVE_HIGH> // col5 in the schematic
        , <&pro_micro 10 GPIO_ACTIVE_HIGH> // col6 in the schematic
        , <&pro_micro 10 GPIO_ACTIVE_HIGH> // col7 in the schematic
        ;
};
